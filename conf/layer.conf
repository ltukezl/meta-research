## conf/layer.conf
```bitbake
# We have a conf and classes directory, add to BBPATH
BBPATH .= ":${LAYERDIR}"

# We have recipes-* directories, add to BBFILES
BBFILES += "${LAYERDIR}/recipes-*/*/*.bb \
            ${LAYERDIR}/recipes-*/*.bb \
            ${LAYERDIR}/recipes-*/*.bbappend"

BBFILE_COLLECTIONS += "meta-research"
BBFILE_PATTERN_meta-research = "^${LAYERDIR}/"
BBFILE_PRIORITY_meta-research = "6"

LAYERDEPENDS_meta-research = "core"
LAYERSERIES_COMPAT_meta-research = "zeus gatesgarth"
```
